/**************************************************************************
 WEMOS D1 mini as MQTT Client
 Author: Stefan Scharrenbach <github@stefan-scharrenbach.de>
 License: MIT
 **************************************************************************/

#include <DHT.h>
#include <Wire.h>
#include <Adafruit_GFX.h>
#include <Adafruit_SSD1306.h>
#include <ESP8266WiFi.h>
#include <PubSubClient.h>

// DHT settings
#define DHTPIN 14 // DHT sensor connected to D5 on the board
#define DHTTYPE DHT11
// OLED settings
#define SCREEN_WIDTH 128 // OLED display width, in pixels
#define SCREEN_HEIGHT 64 // OLED display height, in pixels
#define SCREEN_ADDRESS 0x3C
#define LOGO_HEIGHT   64
#define LOGO_WIDTH    64
const unsigned char fom_logo [] PROGMEM = {
  0xff, 0xff, 0xff, 0xff, 0xff, 0xff, 0xff, 0xff, 0xff, 0xff, 0xff, 0xff, 0xff, 0xff, 0xff, 0xff, 
  0xff, 0xff, 0xff, 0xff, 0xff, 0xff, 0xff, 0xff, 0xff, 0xff, 0xff, 0xff, 0xff, 0xff, 0xff, 0xff, 
  0xff, 0xff, 0xff, 0xff, 0xff, 0xff, 0xff, 0xff, 0xff, 0xff, 0xff, 0xff, 0xff, 0xff, 0xff, 0xff, 
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  0xff, 0xff, 0xff, 0xff, 0xff, 0xff, 0xff, 0xff, 0xff, 0xff, 0xff, 0xff, 0xff, 0xff, 0xff, 0xff
};
// Wifi settings
const char* WIFI_NAME="IoT-Example";
const char* WIFI_PASSWORD="IoTExample";
// MQTT settings
const char* MQTT_BROKER_ADDR="192.168.1.2";
const int MQTT_BROKER_PORT=1883;

// Initialize DHT sensor.
DHT dht(DHTPIN, DHTTYPE);
// Initialize OLED Display
Adafruit_SSD1306 display(SCREEN_WIDTH, SCREEN_HEIGHT, &Wire);
// Initialize Wifi
WiFiClient espWifi;
// Initialize MQTT
PubSubClient mqttClient(espWifi);
String mqttTopic = "iot/" + WiFi.macAddress();

bool get_dht_measurement(float &humidity, float &temp, float &hi) {
  humidity = dht.readHumidity();
  temp = dht.readTemperature();
  if (isnan(humidity) || isnan(temp)) {
    return false;
  }
  hi = dht.computeHeatIndex(temp, humidity, false);
  return true;
}

void serial_print_single_measurement(String name, float value, String unit) {
  Serial.print(name);
  Serial.print(": ");
  Serial.print(value);
  Serial.print(" ");
  Serial.println(unit);
}

void serial_print_measurement(float temp, float humidity, float hi, float runtime) {
  serial_print_single_measurement("runtime", runtime, "ms");
  serial_print_single_measurement("temperature", temp, "°C");
  serial_print_single_measurement("humidity", humidity, "%");
  serial_print_single_measurement("heat_index", hi, "°C");
  Serial.println("-----------------------------------------");
}

void oled_display_logo() {
  display.clearDisplay();
  display.drawBitmap((display.width()-LOGO_WIDTH)/2, 
                     (display.height()-LOGO_HEIGHT)/2, 
                     fom_logo, 
                     LOGO_WIDTH, 
                     LOGO_HEIGHT, 
                     1);
  display.display();
  delay(1000);
}

void oled_add_header() {
  display.clearDisplay();
  display.setCursor(0,0);
  display.println("IoT - Example");
  display.drawLine(0, 9, SCREEN_WIDTH, 9, SSD1306_WHITE);
  display.setCursor(0,15);
}

void oled_add_single_measurement(String name, float value, String unit) {
  display.print(name);
  display.print(": ");
  display.print(value);
  display.print(" ");
  display.println(unit);
}

void oled_display_measurement(float temp, float humidity, float hi, float runtime) {
  oled_add_header();
  oled_add_single_measurement("runtime", runtime/1000, "s");
  oled_add_single_measurement("temperature", temp, "C");
  oled_add_single_measurement("humidity", humidity, "%");
  oled_add_single_measurement("heat index", hi, "C");
  display.display();
}

void mqtt_reconnect() {
  while(!mqttClient.connected()) {
    Serial.print("Reconnecting...");
    if (!mqttClient.connect("ESP8266Client")) {
      Serial.print("failed rc=");
      Serial.print(mqttClient.state());
      Serial.println(" retrying in 5 seconds");
      delay(5000);
    }
  }
}

void mqtt_send_measurement(float temp, float humidity, float hi, float runtime) {
  mqttClient.publish((mqttTopic + "/runtime").c_str(), String(runtime).c_str());
  mqttClient.publish((mqttTopic + "/temperature").c_str(), String(temp).c_str());
  mqttClient.publish((mqttTopic + "/humidity").c_str(), String(humidity).c_str());
  mqttClient.publish((mqttTopic + "/heat_index").c_str(), String(hi).c_str());
}

void oled_setup() {
  display.begin(SSD1306_SWITCHCAPVCC, SCREEN_ADDRESS);
  display.setTextSize(1);
  display.setTextColor(WHITE);
  oled_display_logo();
}

void wifi_setup() {
  WiFi.begin(WIFI_NAME, WIFI_PASSWORD);
  Serial.println("Connecting to Wifi: ");
  Serial.print(WIFI_NAME);
  while(WiFi.status() != WL_CONNECTED) {
    delay(500);
    Serial.print(".");
  }
  Serial.println();
  Serial.println("Connected :-)"); 
  Serial.print("IP address: ");
  Serial.println(WiFi.localIP());
  Serial.print("MAC: ");
  Serial.println(WiFi.macAddress());
}

void mqtt_setup() {
  mqttClient.setServer(MQTT_BROKER_ADDR, MQTT_BROKER_PORT);
}

void setup() {
  // initialize digital pin LED_BUILTIN as an output
  pinMode(LED_BUILTIN, OUTPUT);
  
  // serial init
  Serial.begin(9600);
  
  // display init
  oled_setup();

  // dht11 init
  dht.begin();
  
  // wifi init
  wifi_setup();

  // mqtt init
  mqtt_setup();
}

void loop() {
  digitalWrite(LED_BUILTIN, HIGH);
  // Measurement
  static float humidity = 0.0;
  static float temperature = 0.0;
  static float heat_index = 0.0;
  long long runtime = millis();
  if (!get_dht_measurement(humidity, temperature, heat_index)) {
    delay(1000);
    return;
  }

  // Serial Output
  serial_print_measurement(temperature, humidity, heat_index, runtime);
  

  // OLED Output
  oled_display_measurement(temperature, humidity, heat_index, runtime);

  // MQTT
  mqtt_reconnect();
  mqttClient.loop();
  mqtt_send_measurement(temperature, humidity, heat_index, runtime);
  
  delay(500);
  digitalWrite(LED_BUILTIN, LOW);
  delay(500);
}
